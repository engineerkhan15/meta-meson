## conf/layer.conf
```bitbake
# We have a conf and classes directory, append to BBPATH
BBPATH .= ":${LAYERDIR}"

# We have a recipes directory, add to BBFILES
BBFILES += "${LAYERDIR}/recipes-*/*.bb ${LAYERDIR}/recipes-*/*.bbappend \
            ${LAYERDIR}/recipes-*/*/*.bb ${LAYERDIR}/recipes-*/*/*.bbappend \
            ${LAYERDIR}/recipes-*/*/*/*.bb ${LAYERDIR}/recipes-*/*/*/*.bbappend"

METAMESON_BASE := '${@os.path.normpath("${LAYERDIR}/../")}'
# Prevent current directory creeping into sstate objects. Otherwise, building
# in another TOPDIR will cause recipes using this variable to be rebuilt.
METAMESON_BASE[vardepvalue] = 'meta-meson'
```

## conf/machine/amlogic-p200.conf
```bitbake
# Amlogic P200

require conf/machine/include/amlogic-s905.inc

KERNEL_DEVICETREE += "amlogic/meson-gxbb-p200.dtb"
IMAGE_BOOT_FILES += "Image-meson-gxbb-p200.dtb;meson-gxbb-p200.dtb"

EXTRA_IMAGEDEPENDS += "u-boot"

PREFERRED_PROVIDER_virtual/bootloader = "u-boot-amlogic"
PREFERRED_PROVIDER_u-boot = "u-boot-amlogic"
PREFERRED_VERSION_u-boot-p212 = "v2018.03%"

UBOOT_MACHINE = "gxb_p200_v1_config"
```

## conf/machine/amlogic-p201.conf
```bitbake
# Amlogic P201

require conf/machine/include/amlogic-s905.inc

KERNEL_DEVICETREE += "amlogic/meson-gxbb-p201.dtb"
IMAGE_BOOT_FILES += "Image-meson-gxbb-p201.dtb;meson-gxbb-p201.dtb"

EXTRA_IMAGEDEPENDS += "u-boot"

PREFERRED_PROVIDER_virtual/bootloader = "u-boot-amlogic"
PREFERRED_PROVIDER_u-boot = "u-boot-amlogic"
PREFERRED_VERSION_u-boot-odroidc2 = "v2015.01%"

UBOOT_MACHINE = "gxb_p201_v1_config"
```

## conf/machine/amlogic-p212.conf
```bitbake
# Amlogic P212 board

require conf/machine/include/amlogic-s905x.inc

KERNEL_DEVICETREE += "amlogic/meson-gxl-s905x-p212.dtb"
IMAGE_BOOT_FILES += "Image-meson-gxl-s905x-p212.dtb;meson-gxl-s905x-p212.dtb"

EXTRA_IMAGEDEPENDS += "u-boot"

PREFERRED_PROVIDER_virtual/bootloader = "u-boot-amlogic"
PREFERRED_PROVIDER_u-boot = "u-boot-amlogic"
PREFERRED_VERSION_u-boot-odroidc2 = "v2015.01%"

UBOOT_MACHINE = "gxl_p212_v1_config"
```

## conf/machine/amlogic-p230.conf
```bitbake
# Amlogic P230 board

require conf/machine/include/amlogic-s905d.inc

KERNEL_DEVICETREE += "amlogic/meson-gxl-s905d-p230.dtb"
IMAGE_BOOT_FILES += "Image-meson-gxl-s905d-p230.dtb;meson-gxl-s905d-p230.dtb"

EXTRA_IMAGEDEPENDS += "u-boot"

PREFERRED_PROVIDER_virtual/bootloader = "u-boot-amlogic"
PREFERRED_PROVIDER_u-boot = "u-boot-amlogic"
PREFERRED_VERSION_u-boot-p212 = "v2018.03%"

UBOOT_MACHINE = "gxl_p230_v1_config"
```

## conf/machine/amlogic-p231.conf
```bitbake
# Amlogic P231 board

require conf/machine/include/amlogic-s905d.inc

KERNEL_DEVICETREE += "amlogic/meson-gxl-s905d-p231.dtb"
IMAGE_BOOT_FILES += "Image-meson-gxl-s905d-p231.dtb;meson-gxl-s905d-p231.dtb"

EXTRA_IMAGEDEPENDS += "u-boot"

PREFERRED_PROVIDER_virtual/bootloader = "u-boot-amlogic"
PREFERRED_PROVIDER_u-boot = "u-boot-amlogic"
PREFERRED_VERSION_u-boot-odroidc2 = "v2015.01%"

UBOOT_MACHINE = "gxl_p231_v1_config"
```

## conf/machine/amlogic-q201.conf
```bitbake
# Amlogic Q201 board

require conf/machine/include/amlogic-s912.inc

KERNEL_DEVICETREE += "amlogic/meson-gxm-q201.dtb"
IMAGE_BOOT_FILES += "Image-meson-gxm-q201.dtb;meson-gxm-q201.dtb"

EXTRA_IMAGEDEPENDS += "u-boot"

PREFERRED_PROVIDER_virtual/bootloader = "u-boot-amlogic"
PREFERRED_PROVIDER_u-boot = "u-boot-amlogic"
PREFERRED_VERSION_u-boot-odroidc2 = "v2015.01%"

UBOOT_MACHINE = "gxm_q201_v1_config"
```

## conf/machine/hardkernel-odroidc1.conf
```bitbake
# Hardkernel Odroid-C1 Configurations

require conf/machine/include/amlogic-s805.inc

KERNEL_DEVICETREE += "meson8b-odroidc1.dtb"
IMAGE_BOOT_FILES += "Image-meson8b-odroidc1.dtb;meson8b-odroidc1.dtb"
```

## conf/machine/hardkernel-odroidc2.conf
```bitbake
# Hardkernel Odroid-C2 Configurations

require conf/machine/include/amlogic-s905.inc

KERNEL_DEVICETREE += "amlogic/meson-gxbb-odroidc2.dtb"
IMAGE_BOOT_FILES += "Image-meson-gxbb-odroidc2.dtb;meson-gxbb-odroidc2.dtb"

EXTRA_IMAGEDEPENDS += "u-boot"

PREFERRED_PROVIDER_virtual/bootloader = "u-boot-odroidc2"
PREFERRED_PROVIDER_u-boot = "u-boot-odroidc2"
PREFERRED_VERSION_u-boot-odroidc2 = "v2015.01%"

UBOOT_MACHINE = "odroidc2_config"
```

## conf/machine/include/amlogic-meson.inc
```bitbake
# Amlogic Meson SoCs configurations

MACHINE_EXTRA_RRECOMMENDS = "kernel-modules kernel-devicetree"

SERIAL_CONSOLE = "115200 ttyAML0"

KERNEL_IMAGETYPE = "uImage"
UBOOT_LOADADDRESS = "0x1080000"
UBOOT_ENTRYSYMBOL = "0x1080000"

IMAGE_BOOT_FILES ?= "uImage"

IMAGE_ROOTFS_SIZE = "1048576"
IMAGE_FSTYPES = "ext4 tar.bz2"
WKS_FILE = "sdimage-bootpart.wks"
do_image_wic[depends] += "mtools-native:do_populate_sysroot dosfstools-native:do_populate_sysroot"
```

## conf/machine/khadas-vim2.conf
```bitbake
# Khadas VIM2 board

require conf/machine/include/amlogic-s912.inc

KERNEL_DEVICETREE += "amlogic/meson-gxm-khadas-vi2.dtb"
IMAGE_BOOT_FILES += "Image-meson-gxm-khadas-vim2.dtb;meson-gxm-khadas-vim2.dtb"

EXTRA_IMAGEDEPENDS += "u-boot"

PREFERRED_PROVIDER_virtual/bootloader = "u-boot-khadas-vim"
PREFERRED_PROVIDER_u-boot = "u-boot-khadas-vim"
PREFERRED_VERSION_u-boot-odroidc2 = "v2015.01%"

UBOOT_MACHINE = "kvim2_config"
```

## conf/machine/nexbox-a1.conf
```bitbake
# Nexbox A1 board

require conf/machine/include/amlogic-s912.inc

KERNEL_DEVICETREE += "amlogic/meson-gxm-nexbox-a1.dtb"
IMAGE_BOOT_FILES += "Image-meson-gxm-nexbox-a1.dtb;meson-gxm-nexbox-a1.dtb"
```

## conf/machine/nexbox-a95x-s905.conf
```bitbake
# Nexbox A95 board

require conf/machine/include/amlogic-s905.inc

KERNEL_DEVICETREE += "amlogic/meson-gxbb-nexbox-a95x.dtb"
IMAGE_BOOT_FILES += "Image-meson-gxbb-nexbox-a95x.dtb;meson-gxbb-nexbox-a95x.dtb"
```

## conf/machine/nexbox-a95x-s905x.conf
```bitbake
# Nexbox A95X (s905x) board

require conf/machine/include/amlogic-s905x.inc

KERNEL_DEVICETREE += "amlogic/meson-gxl-s905x-nexbox-a95x.dtb"
IMAGE_BOOT_FILES += "Image-meson-gxl-s905x-nexbox-a95x.dtb;meson-gxl-s905x-nexbox-a95x.dtb"
```

## conf/machine/wetek-hub.conf
```bitbake
# Wetek Hub board

require conf/machine/include/amlogic-s905.inc

KERNEL_DEVICETREE += "amlogic/meson-gxbb-wetek-hub.dtb"
IMAGE_BOOT_FILES += "Image-meson-gxbb-wetek-hub.dtb;meson-gxbb-wetek-hub.dtb"
```

## conf/machine/wetek-play2.conf
```bitbake
# Wetek Play2 board

require conf/machine/include/amlogic-s905.inc

KERNEL_DEVICETREE += "amlogic/meson-gxbb-wetek-play2.dtb"
IMAGE_BOOT_FILES += "Image-meson-gxbb-wetek-play2.dtb;meson-gxbb-wetek-play2.dtb"
```
